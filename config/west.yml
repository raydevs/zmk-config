## config/west.yml
```yaml
manifest:
  remotes:
    - name: raydevs
      url-base: https://github.com/raydevs
  projects:
    - name: zmk
      remote: raydevs
      revision: main
      import: app/west.yml
  self:
    path: config
```
